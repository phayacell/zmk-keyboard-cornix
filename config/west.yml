## config/west.yml
```yaml
manifest:
  remotes:
    - name: zmkfirmware
      url-base: https://github.com/zmkfirmware
    - name: hitsmaxft
      url-base: https://github.com/hitsmaxft
    - name: urob
      url-base: https://github.com/urob
  projects:
    - name: zmk
      remote: zmkfirmware
      revision: v0.3
      clone-depth: 1
      import:
        file: app/west.yml
    - name: zmk-helpers
      remote: urob
      revision: main
      clone-depth: 1
    - name: zmk-rgbled-widget
      remote: hitsmaxft
      revision: main
      clone-depth: 1
    - name: zmk-dongle-display
      remote: hitsmaxft
      revision: bb7d9c34d25a7a3ab301ec09d030beb9e626ce80 # "migrate to lvgl 9" の直前
  self:
    path: config
```
